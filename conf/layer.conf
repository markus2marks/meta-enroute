## conf/layer.conf
```bitbake
# We have a conf and classes directory, add to BBPATH
BBPATH .= ":${LAYERDIR}"

# We have recipes-* directories, add to BBFILES
BBFILES += "${LAYERDIR}/recipes-*/*/*.bb \
            ${LAYERDIR}/recipes-*/*/*.bbappend"

BBFILE_COLLECTIONS += "meta-enroute"
BBFILE_PATTERN_meta-enroute = "^${LAYERDIR}/"
BBFILE_PRIORITY_meta-enroute = "6"

LAYERDEPENDS_meta-enroute = "core"
LAYERSERIES_COMPAT_meta-enroute = "scarthgap"
```
